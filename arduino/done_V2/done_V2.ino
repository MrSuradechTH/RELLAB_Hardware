//config
String machine_name = "TC_07";

//etc
const uint8_t LED = 2;
long millis_old,millis_now,operate_time;
const long over_time = 3600000;

//wifi
#include <WiFi.h>

const char* ssid = "rellab";
const char* password = "1234567890";

//const char* ssid = "rellab_server";
//const char* password = "administrator";

//const char* ssid = "Unknown";
//const char* password = "1234567890";

int reconnect_count = 0;

//ota
#include <ESPmDNS.h>
#include <WiFiUdp.h>
#include <ArduinoOTA.h>

const char* host_name = "TC_07";

//http
#include <HTTPClient.h>
#include <AsyncTCP.h>
#include <ESPAsyncWebServer.h>

HTTPClient http;

bool first_post = true;
const int millis_interval = 1000;
const int http_timeout = 800;

const char* url = "http://192.168.0.165/master.php";

//const char* url = "http://192.168.137.1/master.php";

//const char* url = "http://192.168.100.59/master.php";

//string lib for check alarm in respond text
#include <string.h>
const String alarm_string = "alarm";
bool alarm_check = false;

//store data to rom
#include <Preferences.h>
Preferences preferences;

//memery management
//#include <esp_task_wdt.h>
//esp_task_wdt_config_t wdt_timeout = {
//  .timeout_ms = 60000,
//  .idle_core_mask = 0,
//  .trigger_panic = true,
//};

//oled
#include <SPI.h>
#include <Wire.h>
#include <Adafruit_GFX.h>
#include <Adafruit_SSD1306.h>
#define OLED_RESET 16
Adafruit_SSD1306 display(OLED_RESET);
char str[255];

//max31855
#include <Adafruit_MAX31855.h>
const uint8_t DO = 19;
const uint8_t CS = 5;
const uint8_t CLK = 18;

const uint8_t C_Stack_Size = 200;
double C_Stack[200];
double C,C_Average;
bool first_average = true;

Adafruit_MAX31855 Max31855(CLK, CS, DO); //CLK, CS, DO

//vr
const uint8_t vr = 34;

//piezo
const uint8_t piezo = 4;

//rgb
const uint8_t RGB[3] = {32,33,25};

//cal
//const uint8_t SW = 27;
//int i = 0;
//bool start = false;
//const int gen_start = -100,gen_stop = 200;
//const float gen_step = 0.5;
//const int gen_range = 3001;
//float map_max[3001],map_gen[3001];
//const int step_time = 1000;

float CAL_ADJUST = -1.7;
const float CAL_ADJUST_MIN = -2.00, CAL_ADJUST_MAX = 2.00, CAL_MAX = -100.00, CAL_MIN = 200.00;
const int CAL_RANGE = 3001;
const float MAX_CAL[3001] = {-85.50 ,-85.50 ,-85.25 ,-85.25 ,-85.25 ,-85.25 ,-85.00 ,-85.00 ,-85.00 ,-84.75 ,-84.75 ,-84.75 ,-84.75 ,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197.50 ,197.75};
const float GEN_CAL[3001] = {-100.00 ,-99.90 ,-99.80 ,-99.70 ,-99.60 ,-99.50 ,-99.40 ,-99.30 ,-99.20 ,-99.10 ,-99.00 ,-98.90 ,-98.80 ,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199.90 ,200.00};

//void manual_cal() {
//  if (digitalRead(SW) == LOW) {
//    start = true;
//    Serial.println("Start cal");
//    Serial.println("Gen start : " + String(gen_start));
//    Serial.println("Gen stop : " + String(gen_stop));
//    Serial.println("Gen step : " + String(gen_step));
//    Serial.println("Gen range : " + String(gen_range));
//    digitalWrite(LED, HIGH);
//    delay(1000);
//  }
//
//  while(start == true) {
//    millis_now = millis();
//    if (millis_now - millis_old >= step_time && i <= gen_range) {
//      map_max[i] = Max31855.readCelsius();
//      map_gen[i] = gen_start + (gen_step * i);
//      Serial.println("MAX[" + String(i) + "] = " + String(map_max[i]) + " C : GEN[" + String(i) + "] = " + String(map_gen[i]) + " C");
//      i++;
//      millis_old = millis_now;
//    }else if (i > gen_range){
//      start = false;
//      i = 0;
//      
//      Serial.print("MAX_CAL[");
//      for(int i = 0;i < gen_range;i++) {
//        if (i + 1 >= gen_range) {
//          Serial.print(String(map_max[i]));
//          Serial.println("]");
//        }else {
//          Serial.print(String(map_max[i]) + ",");
//        }
//      }
//  
//      Serial.print("GEN_CAL[");
//      for(int i = 0;i < gen_range;i++) {
//        if (i + 1 >= gen_range) {
//          Serial.print(String(map_gen[i]));
//          Serial.println("]");
//        }else {
//          Serial.print(String(map_gen[i]) + ",");
//        }
//      }
//    }
//    digitalWrite(LED, HIGH);
//    delay(10);
//    digitalWrite(LED, LOW);
//    delay(10);
//    while(start == false && digitalRead(SW) == HIGH) {
//      digitalWrite(LED, HIGH);
//      delay(1000);
//    }
//  }
//}

float CAL(float C) {
  for(int i = 0;i < CAL_RANGE;i++) {
    if (C == MAX_CAL[i]) {
      C = GEN_CAL[i] + CAL_ADJUST;
      return C;
    }
  }

  if (C >= MAX_CAL[CAL_RANGE - 1]) {
    C = GEN_CAL[CAL_RANGE - 1] + CAL_ADJUST;
    return C;
  }else if (C <= MAX_CAL[0]) {
    C = GEN_CAL[0] + CAL_ADJUST;
    return C;
  }else {
    return 0.00;
  }
}

void rgb_color(String color) {
  if (color == "red") {
    digitalWrite(RGB[0], LOW);
    digitalWrite(RGB[1], HIGH);
    digitalWrite(RGB[2], HIGH);
  }else if (color == "green") {
    digitalWrite(RGB[0], HIGH);
    digitalWrite(RGB[1], LOW);
    digitalWrite(RGB[2], HIGH);
  }else if (color == "blue") {
    digitalWrite(RGB[0], HIGH);
    digitalWrite(RGB[1], HIGH);
    digitalWrite(RGB[2], LOW);
  }else if (color == "off") {
    digitalWrite(RGB[0], HIGH);
    digitalWrite(RGB[1], HIGH);
    digitalWrite(RGB[2], HIGH);
  }
}

String set_machine_name(String chip_id_str) {
  if (chip_id_str == "118857916902376") {
    return "TC_07";
  }
}

void core_0(void *not_use) {
  while(true) {
    millis_now = millis();
    if ((millis_now - millis_old >= millis_interval || first_post == true) && WiFi.status() == WL_CONNECTED) {
      Serial.printf("Total heap: %d Free heap: %d", ESP.getHeapSize(), ESP.getFreeHeap());
      if (ESP.getFreeHeap() < 150000) {
        ESP.restart();
      }
//        Serial.printf("Total PSRAM: %d", ESP.getPsramSize());
//        Serial.printf("Free PSRAM: %d\n", ESP.getFreePsram());
  
      String data_string = "machine_name=" + machine_name + "&mode=record_update_data&data={\"temp\":" + String(C) + "}";

      try {
        if(http.POST(data_string) > 0) {
          String response = http.getString();
//            Serial.println(status_code);
          Serial.println(" " + response + " " + machine_name);
          if (response != NULL) {
//              Serial.println("cehck alarm is " + String(response.indexOf(alarm_string)));
            if (response.indexOf(alarm_string) != -1) {
              alarm_check = true;
            }else {
              alarm_check = false;
            }
          }
        } else {
//            Serial.print("Error on sending POST: ");
          first_post = true;
//            Serial.println(status_code);
        }

        first_post = false;
        millis_old = millis_now;
        digitalWrite(LED, !digitalRead(LED));
      } catch(...) {
//          ESP.restart();
        first_post = true;
      }
    }
    
    vTaskDelay(pdMS_TO_TICKS(100));
  }

  vTaskDelete(NULL);
}

void core_1(void *not_use) {
  while(true) {
    //  String dip_state = String(digitalRead(dip[0])) + String(digitalRead(dip[1])) + String(digitalRead(dip[2])) + String(digitalRead(dip[3]));

    if (alarm_check) {
      rgb_color("red");
      digitalWrite(piezo, HIGH);
    }else {
      rgb_color("green");
      digitalWrite(piezo, LOW);
    }
  
    CAL_ADJUST = ((analogRead(vr) / 4095.00) * (abs(CAL_ADJUST_MIN) + abs(CAL_ADJUST_MAX))) - CAL_ADJUST_MAX;
  
    operate_time = millis();
    if(operate_time > over_time) {
      ESP.restart();
    }
    
    if (!Serial)  {
      Serial.println("Connecting to Serial...");
      while (!Serial)  {
        delay(10);
        Serial.print(".");
        reconnect_count++;
        if (reconnect_count >= 5000) {
          ESP.restart();
        }
      }
  
      reconnect_count = 0;
      
      Serial.println("Connected to Serial");
  
      first_average = true;
      first_post = true;
    }
    
    C = Max31855.readCelsius();
  //  Serial.println(String(C) + " : " + String(CAL_ADJUST));
    C = CAL(C);
  
    if (first_average == true) {
      C = preferences.getDouble("C", C);
      for (uint8_t i = 0; i < C_Stack_Size;i++) {
        C_Stack[i] = C;
      }
    
      first_average = false;
    }
    
    for (uint8_t i = 0; i < C_Stack_Size - 1;i++) {
      C_Stack[i] = C_Stack[i + 1];
    }
    C_Stack[C_Stack_Size - 1] = C;
  
    for (uint8_t i = 0; i < C_Stack_Size;i++) {
      C_Average += C_Stack[i];
    }
  
    C = C_Average / C_Stack_Size;
    C_Average = 0;
    
    display.clearDisplay();
    display.setCursor(0,0);
    
    if (WiFi.status() != WL_CONNECTED) {
      display.println("Wifi : Fail");
      display.setCursor(0,8);
      display.println("IP : XXX.XXX.XXX.XXX");
      display.setCursor(0,16);
      display.println("RSSI : XXX dBm");
      WiFi.begin(ssid, password);
  
      Serial.println("Connecting to WiFi...");
      while (WiFi.status() != WL_CONNECTED) {
        delay(10);
        Serial.print(".");
        reconnect_count++;
        if (reconnect_count >= 5000) {
          ESP.restart();
        }
      }
      
      reconnect_count = 0;
      
      Serial.println("Connected to WiFi");
  
      http.begin(url);
      http.setTimeout(http_timeout);
      http.addHeader("Content-Type", "application/x-www-form-urlencoded");
  
      first_average = true;
      first_post = true;
  
      ArduinoOTA.setHostname(host_name);
  
      ArduinoOTA
        .onStart([]() {
          String type;
          if (ArduinoOTA.getCommand() == U_FLASH)
            type = "sketch";
          else
            type = "filesystem";
          Serial.println("Start updating " + type);
        })
        .onEnd([]() {
          Serial.println("\nEnd");
        })
        .onProgress([](unsigned int progress, unsigned int total) {
          Serial.printf("Progress: %u%%\r", (progress / (total / 100)));
        })
        .onError([](ota_error_t error) {
          Serial.printf("Error[%u]: ", error);
          if (error == OTA_AUTH_ERROR) Serial.println("Auth Failed");
          else if (error == OTA_BEGIN_ERROR) Serial.println("Begin Failed");
          else if (error == OTA_CONNECT_ERROR) Serial.println("Connect Failed");
          else if (error == OTA_RECEIVE_ERROR) Serial.println("Receive Failed");
          else if (error == OTA_END_ERROR) Serial.println("End Failed");
      });
  
      ArduinoOTA.begin();
    }else {
      display.println("Wifi : Connected");
      display.setCursor(0,8);
      display.println("IP : " + WiFi.localIP().toString());
      display.setCursor(0,16);
      display.println("RSSI : " + String(WiFi.RSSI()) + " dBm");
    }
  
    ArduinoOTA.handle();
    
    display.setCursor(0,24);
    
    if (isnan(C)) {
      display.println("Temp : Error");
    }else {
      sprintf(str, "%4.2f", C);
      display.println("Temp : " + String(str) + " C");
      preferences.putDouble("C", C);
    }
    display.display();
    
    vTaskDelay(pdMS_TO_TICKS(100));
  }

  vTaskDelete(NULL);
}

void setup() {
//  pinMode(SW, INPUT_PULLUP);
  
  pinMode(LED, OUTPUT);
  
  pinMode(piezo, OUTPUT);

  pinMode(RGB[0], OUTPUT);
  pinMode(RGB[1], OUTPUT);
  pinMode(RGB[2], OUTPUT);

  display.begin(SSD1306_SWITCHCAPVCC, 0x3c);
  display.clearDisplay();
  display.setTextSize(1);
  display.setTextColor(WHITE);
  
  Serial.begin(2000000);
  while (!Serial) delay(10);

  display.clearDisplay();
  display.setCursor(0,0);
  Serial.println("Starting...");
  display.println("Starting...");
  display.display();
  
  WiFi.mode(WIFI_STA);

  rgb_color("off");

  uint64_t chip_id = ESP.getEfuseMac();

  machine_name = set_machine_name(String(chip_id));

  Serial.print("machine name is " + machine_name + " chipid is " + String(chip_id));

  preferences.begin("backup", false);

//  esp_task_wdt_init(&wdt_timeout);
//  esp_task_wdt_add(NULL);

  xTaskCreatePinnedToCore(
    core_0,       // Function to implement the task
    "core_0",     // Name of the task
    10000,        // Stack size in words
    NULL,         // Task input parameter
    1,            // Priority of the task
    NULL,         // Task handle
    0             // Core ID
  );

  xTaskCreatePinnedToCore(
    core_1,       // Function to implement the task
    "core_1",     // Name of the task
    10000,        // Stack size in words
    NULL,         // Task input parameter
    1,            // Priority of the task
    NULL,         // Task handle
    1             // Core ID
  );
}

void loop() {
//  manual_cal();
}
